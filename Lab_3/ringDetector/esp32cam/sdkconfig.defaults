## proyecto_final/Tools/esp_cam_capture/sdkconfig.defaults
```kconfig
CONFIG_ESP_TASK_WDT_INIT=y
CONFIG_ESP_TASK_WDT_TIMEOUT_S=15
CONFIG_ESP_TASK_WDT_PANIC=y
CONFIG_SPIRAM=y
```

## proyecto_final/camara_beacon/main/Kconfig.projbuild
```kconfig
menu "Identifier detector"

config IDENTIFIER_USE_CAMERA
    bool "Use ESP-CAM as image source"
    default y

config IDENTIFIER_LED_GPIO
    int "Detection LED GPIO"
    default -1
    help
        GPIO driven high when the identifier is detected. Set to -1 to disable.

config IDENTIFIER_MIN_MARGIN
    int "Minimum margin over absent class"
    default 0

config IDENTIFIER_PERIOD_MS
    int "Inference period in milliseconds"
    default 67
    range 20 10000
    help
        Target interval between inference starts. 67 ms is approximately 15 FPS.

endmenu
```

## proyecto_final/camara_beacon/sdkconfig.defaults
```kconfig
CONFIG_LOG_DEFAULT_LEVEL_INFO=y
CONFIG_ESP_MAIN_TASK_STACK_SIZE=8192
CONFIG_FREERTOS_HZ=1000
CONFIG_COMPILER_OPTIMIZATION_PERF=y
CONFIG_ESP_DEFAULT_CPU_FREQ_MHZ_240=y
CONFIG_NN_OPTIMIZED=y
CONFIG_IDENTIFIER_USE_CAMERA=y
CONFIG_IDENTIFIER_LED_GPIO=-1
CONFIG_IDENTIFIER_MIN_MARGIN=0
CONFIG_IDENTIFIER_PERIOD_MS=67
```

## proyecto_final/camara_piso/sdkconfig.defaults
```kconfig
CONFIG_LOG_DEFAULT_LEVEL_INFO=y
CONFIG_ESP_MAIN_TASK_STACK_SIZE=8192
CONFIG_FREERTOS_HZ=1000
CONFIG_ESP_BROWNOUT_DET=n
```
